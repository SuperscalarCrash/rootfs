## Config.in
```kconfig
menu "Gemmont root filesystem"

comment "Board configuration is provided by gemmont_chiplab_la32r_defconfig"

source "$BR2_EXTERNAL_GEMMONT_ROOTFS_PATH/package/gemmont-native-toolchain/Config.in"
source "$BR2_EXTERNAL_GEMMONT_ROOTFS_PATH/package/fastfetch/Config.in"

endmenu
```

## configs/gemmont_chiplab_la32r_defconfig
```kconfig
BR2_loongarch32r=y
BR2_LOONGARCH_FPU_NONE=y
BR2_LOONGARCH_SIMD_NONE=y
BR2_LOONGARCH_ABI_ILP32S=y
BR2_OPTIMIZE_S=y
BR2_SHARED_LIBS=y
BR2_TOOLCHAIN_EXTERNAL=y
BR2_TOOLCHAIN_EXTERNAL_CUSTOM=y
BR2_TOOLCHAIN_EXTERNAL_PREINSTALLED=y
BR2_TOOLCHAIN_EXTERNAL_PATH="$(BR2_EXTERNAL_GEMMONT_ROOTFS_PATH)/.toolchains/gcc-16.1.0-la32r"
BR2_TOOLCHAIN_EXTERNAL_CUSTOM_PREFIX="loongarch32-linux-gnusf"
BR2_TOOLCHAIN_EXTERNAL_GCC_16=y
BR2_TOOLCHAIN_EXTERNAL_HEADERS_7_0=y
BR2_TOOLCHAIN_EXTERNAL_CUSTOM_GLIBC=y
BR2_TOOLCHAIN_EXTERNAL_CXX=y
BR2_TOOLCHAIN_EXTERNAL_HAS_SSP=y
BR2_TOOLCHAIN_EXTERNAL_HAS_SSP_STRONG=y
# BR2_TOOLCHAIN_EXTERNAL_INET_RPC is not set
BR2_TARGET_GENERIC_HOSTNAME="gemmont"
BR2_TARGET_GENERIC_ISSUE="Gemmont Chiplab LA32R"
BR2_SYSTEM_DHCP="eth0"
BR2_TARGET_GENERIC_GETTY_PORT="ttyS0"
BR2_TARGET_GENERIC_GETTY_BAUDRATE_115200=y
BR2_GENERATE_LOCALE="C.UTF-8"
BR2_ROOTFS_DEVICE_CREATION_DYNAMIC_EUDEV=y
# BR2_PACKAGE_EUDEV_MODULE_LOADING is not set
# BR2_PACKAGE_EUDEV_ENABLE_HWDB is not set
BR2_ROOTFS_OVERLAY="$(BR2_EXTERNAL_GEMMONT_ROOTFS_PATH)/board/gemmont/chiplab/rootfs-overlay"
BR2_ROOTFS_POST_BUILD_SCRIPT="$(BR2_EXTERNAL_GEMMONT_ROOTFS_PATH)/board/gemmont/chiplab/post-build.sh"
BR2_PACKAGE_BUSYBOX=y
BR2_PACKAGE_BUSYBOX_SHOW_OTHERS=y
BR2_PACKAGE_COREMARK=y
BR2_PACKAGE_DHRYSTONE=y
BR2_PACKAGE_BASH=y
BR2_PACKAGE_GREP=y
BR2_PACKAGE_ZSTD=y
BR2_PACKAGE_TREE=y
BR2_PACKAGE_HTOP=y
BR2_PACKAGE_LRZSZ=y
BR2_PACKAGE_TMUX=y
BR2_PACKAGE_VIM=y
BR2_PACKAGE_VIM_RUNTIME=y
BR2_PACKAGE_ANDROID_TOOLS=y
BR2_PACKAGE_ANDROID_TOOLS_ADB=y
BR2_PACKAGE_ANDROID_TOOLS_ADBD=y
BR2_PACKAGE_FASTFETCH=y
BR2_PACKAGE_FB_TEST_APP=y
BR2_PACKAGE_FBDUMP=y
BR2_PACKAGE_FBV=y
BR2_PACKAGE_XORG7=y
BR2_PACKAGE_XSERVER_XORG_SERVER=y
BR2_PACKAGE_XSERVER_XORG_SERVER_MODULAR=y
BR2_PACKAGE_XDRIVER_XF86_INPUT_EVDEV=y
BR2_PACKAGE_XDRIVER_XF86_VIDEO_FBDEV=y
BR2_PACKAGE_XAPP_SETXKBMAP=y
BR2_PACKAGE_XAPP_XCALC=y
BR2_PACKAGE_XAPP_XCLOCK=y
BR2_PACKAGE_XAPP_XDPYINFO=y
BR2_PACKAGE_XAPP_XEDIT=y
BR2_PACKAGE_XAPP_XEV=y
BR2_PACKAGE_XAPP_XEYES=y
BR2_PACKAGE_XAPP_XINIT=y
BR2_PACKAGE_XAPP_XINPUT=y
BR2_PACKAGE_XAPP_XKILL=y
BR2_PACKAGE_XAPP_XLOAD=y
BR2_PACKAGE_XAPP_XLOGO=y
BR2_PACKAGE_XAPP_XMESSAGE=y
BR2_PACKAGE_XAPP_XPROP=y
BR2_PACKAGE_XAPP_XRANDR=y
BR2_PACKAGE_XAPP_XRDB=y
BR2_PACKAGE_XAPP_XSET=y
BR2_PACKAGE_XAPP_XSETROOT=y
BR2_PACKAGE_XAPP_XWININFO=y
BR2_PACKAGE_XAPP_XWD=y
BR2_PACKAGE_XAPP_XWUD=y
BR2_PACKAGE_XLIB_LIBXPM=y
BR2_PACKAGE_DEJAVU=y
# BR2_PACKAGE_DEJAVU_MONO is not set
BR2_PACKAGE_DEJAVU_SANS=y
# BR2_PACKAGE_DEJAVU_SERIF is not set
# BR2_PACKAGE_DEJAVU_SANS_CONDENSED is not set
# BR2_PACKAGE_DEJAVU_SERIF_CONDENSED is not set
BR2_PACKAGE_XTERM=y
BR2_PACKAGE_FLUXBOX=y
BR2_PACKAGE_NODM=y
BR2_PACKAGE_OPENSSH=y
BR2_PACKAGE_OPENSSH_CLIENT=y
BR2_PACKAGE_OPENSSH_SERVER=y
BR2_PACKAGE_OPENSSH_KEY_UTILS=y
# BR2_PACKAGE_OPENSSH_SANDBOX is not set
BR2_PACKAGE_NGINX=y
BR2_PACKAGE_NGINX_HTTP_SSL_MODULE=y
BR2_PACKAGE_NGINX_HTTP_V2_MODULE=y
BR2_PACKAGE_NGINX_HTTP_STUB_STATUS_MODULE=y
BR2_PACKAGE_NTP=y
BR2_PACKAGE_NTP_NTPDATE=y
BR2_PACKAGE_DHCP=y
BR2_PACKAGE_DHCP_CLIENT=y
BR2_PACKAGE_IPUTILS=y
BR2_PACKAGE_PYTHON3=y
BR2_PACKAGE_PYTHON3_BZIP2=y
BR2_PACKAGE_PYTHON3_READLINE=y
BR2_PACKAGE_PYTHON3_SSL=y
BR2_PACKAGE_PYTHON3_XZ=y
BR2_PACKAGE_PYTHON3_ZLIB=y
BR2_PACKAGE_CA_CERTIFICATES=y
BR2_PACKAGE_IPROUTE2=y
BR2_PACKAGE_ETHTOOL=y
BR2_PACKAGE_EVTEST=y
BR2_PACKAGE_LIBOPENSSL_BIN=y
BR2_PACKAGE_MTD=y
# BR2_PACKAGE_MTD_FLASHCP is not set
# BR2_PACKAGE_MTD_FLASH_ERASE is not set
# BR2_PACKAGE_MTD_FLASH_LOCK is not set
# BR2_PACKAGE_MTD_FLASH_UNLOCK is not set
BR2_PACKAGE_MTD_FSCKUBIFS=y
BR2_PACKAGE_MTD_LSMTD=y
# BR2_PACKAGE_MTD_MTD_DEBUG is not set
BR2_PACKAGE_MTD_NANDDUMP=y
# BR2_PACKAGE_MTD_NANDTEST is not set
# BR2_PACKAGE_MTD_NANDWRITE is not set
BR2_PACKAGE_MTD_MTDINFO=y
BR2_PACKAGE_MTD_UBIATTACH=y
BR2_PACKAGE_MTD_UBIDETACH=y
BR2_PACKAGE_MTD_UBIFORMAT=y
BR2_PACKAGE_MTD_UBIMKVOL=y
BR2_PACKAGE_MTD_UBINFO=y
BR2_PACKAGE_MTD_UBIRMVOL=y
BR2_PACKAGE_MTD_UBIUPDATEVOL=y
BR2_PACKAGE_GEMMONT_NATIVE_TOOLCHAIN=y
BR2_TARGET_ROOTFS_CPIO=y
BR2_TARGET_ROOTFS_CPIO_GZIP=y
BR2_TARGET_ROOTFS_TAR=y
BR2_TARGET_ROOTFS_TAR_ZSTD=y
BR2_TARGET_ROOTFS_UBI=y
BR2_TARGET_ROOTFS_UBI_PEBSIZE=0x20000
BR2_TARGET_ROOTFS_UBI_SUBSIZE=2048
BR2_TARGET_ROOTFS_UBIFS_LEBSIZE=0x1f000
BR2_TARGET_ROOTFS_UBIFS_MINIOSIZE=0x800
BR2_TARGET_ROOTFS_UBIFS_MAXLEBCNT=864
```

## package/fastfetch/Config.in
```kconfig
config BR2_PACKAGE_FASTFETCH
	bool "fastfetch"
	depends on BR2_USE_MMU
	depends on BR2_TOOLCHAIN_HAS_THREADS
	help
	  Fastfetch is a system information tool similar to Neofetch.
	  This package uses an embedded-friendly configuration without
	  desktop graphics, multimedia or scripting integrations.  Its
	  default summary omits package-manager detection.

	  https://github.com/fastfetch-cli/fastfetch

comment "fastfetch needs a toolchain with threads"
	depends on !BR2_TOOLCHAIN_HAS_THREADS
```

## package/gemmont-native-toolchain/Config.in
```kconfig
config BR2_PACKAGE_GEMMONT_NATIVE_TOOLCHAIN
	bool "Gemmont GCC 16 native toolchain"
	help
	  Install the self-contained LA32R-native GCC 16.1.0 C compiler,
	  Binutils 2.46.1 and development sysroot under
	  /opt/gemmont-gcc-16.1.0, with their accompanying licenses.

	  The payload is built in advance by
	  scripts/build-gcc16-native-toolchain.sh.  Convenience links
	  such as /usr/bin/gcc, /usr/bin/as and /usr/bin/ld are added so
	  programs can be compiled directly on the Gemmont board.
```
